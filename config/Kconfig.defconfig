## config/Kconfig.defconfig
```kconfig
if SHIELD_CALDERALEFT

config ZMK_KEYBOARD_NAME
    default "Caldera"

config ZMK_SPLIT_ROLE_CENTRAL
    default y

endif

if SHIELD_CALDERALEFT || SHIELD_CALDERARIGHT

config ZMK_SPLIT
    default y

endif
```

## config/Kconfig.shield
```kconfig
config SHIELD_CALDERALEFT
    def_bool $(shields_list_contains,calderaleft)

config SHIELD_CALDERARIGHT
    def_bool $(shields_list_contains,calderaright)
```
